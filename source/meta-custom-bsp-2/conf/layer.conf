## source/meta-custom-bsp-2/conf/layer.conf
```bitbake
BBPATH .= ":${LAYERDIR}"

BBFILE_COLLECTIONS += "custom-bsp-2"

BBFILES += "\
  ${LAYERDIR}/recipes-*/*/*.bb \
  ${LAYERDIR}/recipes-*/*/*.bbappend \
  ${LAYERDIR}/recipes-*/*/*/*.bbappend \
  ${LAYERDIR}/recipes-*/*/*/*/*.bbappend \
"

BBFILE_PATTERN_custom-bsp-2 := "^${LAYERDIR}/"
BBFILE_PRIORITY_custom-bsp-2 = "120"
LAYERSERIES_COMPAT_custom-bsp-2 = "scarthgap"
```

## source/meta-custom-bsp-2/conf/machine/include/custom-jon-bb0.inc
```bitbake
# Common carrier-board settings 

MACHINEOVERRIDES .= ":custom-jon-bb0"

TEGRA_PLUGIN_MANAGER_OVERLAYS:append = " tegra234-p3767-camera-p3768-vc_mipi-dual.dtbo"

USE_REDUNDANT_FLASH_LAYOUT_DEFAULT = "1"
ROOTFSPART_SIZE_REDUNDANT = "10737418240"
```

## source/meta-custom-bsp/conf/distro/layer.conf
```bitbake
BBPATH .= ":${LAYERDIR}"
BBFILES += "${LAYERDIR}/recipes-*/*/*.bb "
BBFILE_COLLECTIONS += "meta-custom-bsp"
BBFILE_PATTERN_meta-custom-bsp = "^${LAYERDIR}/"
BBFILE_PRIORITY_meta-custom-bsp = "5"

LAYERDEPENDS_meta-custom-bsp = "core"
```

## source/meta-custom-bsp/conf/layer.conf
```bitbake
BBPATH .= ":${LAYERDIR}"

BBFILE_COLLECTIONS += "meta-custom-bsp"

BBFILES += "\
  ${LAYERDIR}/recipes-*/*/*.bb \
  ${LAYERDIR}/recipes-*/*/*.bbappend \
"

BBFILE_PATTERN_meta-custom-bsp := "^${LAYERDIR}/"
BBFILE_PRIORITY_meta-custom-bsp = "120"
LAYERSERIES_COMPAT_meta-custom-bsp = "scarthgap"
```

## source/meta-os/conf/distro/os.conf
```bitbake
DISTRO = "os"

require conf/distro/defaultsetup.conf

DISTROOVERRIDES:append = ":os"

DISTRO_FEATURES:append = " systemd pam seccomp usrmerge virtualization"

DISTRO_FEATURES:append = " os-secureboot-handoff"
DISTROOVERRIDES:append = ":os-secureboot-handoff"

VIRTUAL-RUNTIME_init_manager = "systemd"
VIRTUAL-RUNTIME_initscripts = ""

IMAGE_INSTALL:append = " \
    podman \
    conmon \
    crun \
    slirp4netns \
    fuse-overlayfs \
    cni \
"

IMAGE_INSTALL:append = " \
    python3-core \
    python3-modules \
    curl \
"
IMAGE_INSTALL:append = " \
    file \
    curl \
    busybox \
"
```

## source/meta-os/conf/layer.conf
```bitbake
BBPATH .= ":${LAYERDIR}"

BBFILE_COLLECTIONS += "os-os"

BBFILES += "\
  ${LAYERDIR}/recipes-*/*/*.bb \
  ${LAYERDIR}/recipes-*/*/*.bbappend \
  ${LAYERDIR}/recipes-*/*/*/*.bbappend \
  ${LAYERDIR}/recipes-*/*/*/*/*.bbappend \
"

BBFILE_PATTERN_os-os := "^${LAYERDIR}/"
BBFILE_PRIORITY_os-os = "120"
LAYERSERIES_COMPAT_os-os = "scarthgap"
```
